## configs/tp2bmc_defconfig
```kconfig
CONFIG_ARM=y
CONFIG_ARCH_SUNXI=y
CONFIG_DEFAULT_DEVICE_TREE="sun8i-t113s-turing-pi2-v2.4"
CONFIG_SPL=y
CONFIG_IDENT_STRING=" Turing Machines, Inc."
CONFIG_DRAM_SUNXI_ODT_EN=0
CONFIG_DRAM_SUNXI_TPR0=0x004a2195
CONFIG_DRAM_SUNXI_TPR11=0x340000
CONFIG_DRAM_SUNXI_TPR12=0x46
CONFIG_DRAM_SUNXI_TPR13=0x34000100
CONFIG_MACH_SUN8I_R528=y
CONFIG_DRAM_CLK=792
CONFIG_DRAM_ZQ=8092667
CONFIG_SUNXI_MINIMUM_DRAM_MB=128
CONFIG_I2C2_ENABLE=y
CONFIG_SPL_SPI_SUNXI=y
CONFIG_SPL_SPI_SUNXI_NAND=y
CONFIG_SPL_SPI_SUNXI_NAND_ASSUMED_PAGESIZE=0x800
CONFIG_TARGET_TURINGPI2=y
CONFIG_LTO=y
CONFIG_BLOBLIST=y
CONFIG_BLOBLIST_FIXED=y
CONFIG_BLOBLIST_ADDR=0x41700000
CONFIG_SPL_BLOBLIST=y
CONFIG_SPL_BLOBLIST_FIXED=y
CONFIG_SPL_SERIAL=y
CONFIG_SPL_I2C=y
CONFIG_CMD_BLOBLIST=y
CONFIG_CMD_I2C=y
CONFIG_CMD_TPI_INFO=y
CONFIG_CMD_MTD=y
CONFIG_CMD_USB_MASS_STORAGE=y
CONFIG_CMD_LINK_LOCAL=y
CONFIG_CMD_UBI=y
# CONFIG_OF_UPSTREAM is not set
# Embedded DTB: OF_SEPARATE at _end can be past SPL-loaded bytes → fdtdec_setup fails silently (INITCALL hang).
CONFIG_OF_EMBED=y
# CONFIG_OF_SEPARATE is not set
CONFIG_OF_CONTROL=y
CONFIG_OF_LIST="sun8i-t113s-turing-pi2-v2.4 sun8i-t113s-turing-pi2-v2.5"
CONFIG_MULTI_DTB_FIT=y
CONFIG_ENV_IS_IN_UBI=y
CONFIG_ENV_FAT_FILE="boot/uboot.env"
CONFIG_ENV_UBI_PART="ubi"
CONFIG_ENV_UBI_VOLUME="uboot-env"
# Match Linux UBI on SPI NAND (dmesg: VID header offset 2048, data offset 4096).
CONFIG_UBI_DEFAULT_VID_OFFSET=2048
CONFIG_ENV_VARS_UBOOT_RUNTIME_CONFIG=y
CONFIG_ENV_USE_DEFAULT_ENV_TEXT_FILE=y
CONFIG_ENV_DEFAULT_ENV_TEXT_FILE="board/tp2bmc/uboot.env"
CONFIG_VERSION_VARIABLE=y
CONFIG_NETCONSOLE=y
CONFIG_IPV6=y
CONFIG_BUTTON=y
CONFIG_BUTTON_GPIO=y
CONFIG_FASTBOOT_OEM_RUN=y
CONFIG_SPL_SYS_I2C_LEGACY=y
CONFIG_SYS_I2C_MVTWSI=y
CONFIG_LED=y
CONFIG_LED_GPIO=y
CONFIG_MISC=y
CONFIG_NVMEM=y
CONFIG_I2C_EEPROM=y
CONFIG_SYS_I2C_EEPROM_ADDR=0x50
CONFIG_MTD=y
CONFIG_DM_MTD=y
CONFIG_MTD_SPI_NAND=y
CONFIG_PHY_REALTEK=y
CONFIG_SUN8I_EMAC=y
CONFIG_CONS_INDEX=4
CONFIG_SPI=y
CONFIG_DM_USB_GADGET=y
CONFIG_USB_MUSB_GADGET=y
CONFIG_USB_FUNCTION_ACM=y
CONFIG_FS_EROFS=y
```
